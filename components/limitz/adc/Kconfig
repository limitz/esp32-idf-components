## components/limitz/i2cbus/Kconfig
```kconfig
menu "LIMITZ I2C"

	config LMTZ_I2C_BUS0_EN
	bool "Enable i2c bus 0"

		config LMTZ_I2C_BUS0_SDA
		depends on LMTZ_I2C_BUS0_EN
		int "SDA Pin number" 
		range 0 36
		default 21
	
		config LMTZ_I2C_BUS0_SCL
		depends on LMTZ_I2C_BUS0_EN
		int "SCL Pin number"
		range 0 36
		default 22
	
		choice LMTZ_I2C_BUS0_FREQ_SELECT	
		depends on LMTZ_I2C_BUS0_EN
		prompt "Frequency"
			config  LMTZ_I2C_BUS0_FREQ_1
			bool "1 Mhz"

			config  LMTZ_I2C_BUS0_FREQ_5
			bool "5 Mhz"

			config  LMTZ_I2C_BUS0_FREQ_10
			bool "10 Mhz"

			config  LMTZ_I2C_BUS0_FREQ_20
			bool "20 Mhz"

		endchoice

		config LMTZ_I2C_BUS0_FREQ
		depends on LMTZ_I2C_BUS0_EN
		int
		default 1000000  if LMTZ_I2C_BUS0_FREQ_1
		default 5000000  if LMTZ_I2C_BUS0_FREQ_5
		default 10000000 if LMTZ_I2C_BUS0_FREQ_10
		default 20000000 if LMTZ_I2C_BUS0_FREQ_20

	config LMTZ_I2C_BUS1_EN
	bool "Enable i2c bus 1"

		config LMTZ_I2C_BUS1_SDA
		depends on LMTZ_I2C_BUS1_EN
		int "SDA Pin number" 
		range 0 36
		default 26
	
		config LMTZ_I2C_BUS1_SCL
		depends on LMTZ_I2C_BUS1_EN
		int "SCL Pin number"
		range 0 36
		default 27
	
		choice LMTZ_I2C_BUS1_FREQ_SELECT	
		depends on LMTZ_I2C_BUS1_EN
		prompt "Frequency"
			config  LMTZ_I2C_BUS1_FREQ_1
			bool "1 Mhz"

			config  LMTZ_I2C_BUS1_FREQ_5
			bool "5 Mhz"

			config  LMTZ_I2C_BUS1_FREQ_10
			bool "10 Mhz"

			config  LMTZ_I2C_BUS1_FREQ_20
			bool "20 Mhz"

		endchoice

		config LMTZ_I2C_BUS1_FREQ
		depends on LMTZ_I2C_BUS1_EN
		int
		default 1000000  if LMTZ_I2C_BUS1_FREQ_1
		default 5000000  if LMTZ_I2C_BUS1_FREQ_5
		default 10000000 if LMTZ_I2C_BUS1_FREQ_10
		default 20000000 if LMTZ_I2C_BUS1_FREQ_20

		menu "Attached peripherals"
		depends on LMTZ_I2C_BUS1_EN
		
			menuconfig LMTZ_I2C_FT5206_EN
			bool "Enable FT5206 @0x38"
			default n

				config LMTZ_I2C_FT5206_THRESHOLD_TOUCH
				depends on LMTZ_I2C_FT5206_EN
				int "Touch threshold value"
				range 0 255
				default 10

			menuconfig LMTZ_I2C_MPR121_EN
			bool "Enable MPR121 @0x5A"
			default n

				config LMTZ_I2C_MPR121_THRESHOLD_TOUCH
				depends on LMTZ_I2C_MPR121_EN
				int "Touch threshold value"
				range 0 16
				default 12

				config LMTZ_I2C_MPR121_THRESHOLD_RELEASE
				depends on LMTZ_I2C_MPR121_EN
				int "Release threshold value"
				range 0 16
				default 6


			choice LMTZ_I2C_HT16K33_B10_TYPE
			default LMTZ_I2C_BUS1_HT16K33_0x70_DIS
			prompt "HT16K33 @0x70"
			
				config LMTZ_I2C_BUS1_HT16K33_0x70_DIS
				bool "Disabled"

				config LMTZ_I2C_BUS1_HT16K33_0x70_NUMERIC_X4
				bool "Adafruit 4 digit numeric"

				config LMTZ_I2C_BUS1_HT16K33_0x70_NUMERIC_X4L
				bool "Adafruit 4 digit numeric LARGE"
				
				config LMTZ_I2C_BUS1_HT16K33_0x70_ALPHANUMERIC_X4
				bool "Adafruit 4 character alphanumeric"

				config LMTZ_I2C_BUS1_HT16K33_0x70_MATRIX
				bool "Adafruit 8x8 matrix"

				config LMTZ_I2C_BUS1_HT16K33_0x70_OTHER
				bool "Other HT16K33"

			endchoice

			config LMTZ_I2C_BUS1_HT16K33_0x70_EN
			depends on LMTZ_I2C_BUS1_EN
			bool 
			default n if LMTZ_i2C_BUS1_HT16K33_0x70_DIS
			default y

			config LMTZ_I2C_BUS1_HT16K33_0x70_TYPE
			depends on LMTZ_I2C_BUS1_EN
			int
			default 0 if LMTZ_I2C_BUS1_HT16K33_0x70_OTHER
			default 1 if LMTZ_I2C_BUS1_HT16K33_0x70_NUMERIC_X4
			default 2 if LMTZ_I2C_BUS1_HT16K33_0x70_NUMERIC_X4L
			default 3 if LMTZ_I2C_BUS1_HT16K33_0x70_ALPHANUMERIC_X4
			default 4 if LMTZ_I2C_BUS1_HT16K33_0x70_MATRIX
			default -1

			choice LMTZ_I2C_HT16K33_B11_TYPE
			default LMTZ_I2C_BUS1_HT16K33_0x71_DIS
			prompt "HT16K33 @0x71"
			
				config LMTZ_I2C_BUS1_HT16K33_0x71_DIS
				bool "Disabled"

				config LMTZ_I2C_BUS1_HT16K33_0x71_NUMERIC_X4
				bool "Adafruit 4 digit numeric"

				config LMTZ_I2C_BUS1_HT16K33_0x71_NUMERIC_X4L
				bool "Adafruit 4 digit numeric LARGE"
				
				config LMTZ_I2C_BUS1_HT16K33_0x71_ALPHANUMERIC_X4
				bool "Adafruit 4 character alphanumeric"

				config LMTZ_I2C_BUS1_HT16K33_0x71_MATRIX
				bool "Adafruit 8x8 matrix"

				config LMTZ_I2C_BUS1_HT16K33_0x71_OTHER
				bool "Other HT16K33"

			endchoice

			config LMTZ_I2C_BUS1_HT16K33_0x71_EN
			depends on LMTZ_I2C_BUS1_EN
			bool 
			default n if LMTZ_i2C_BUS1_HT16K33_0x71_DIS
			default y

			config LMTZ_I2C_BUS1_HT16K33_0x71_TYPE
			depends on LMTZ_I2C_BUS1_EN
			int
			default 0 if LMTZ_I2C_BUS1_HT16K33_0x71_OTHER
			default 1 if LMTZ_I2C_BUS1_HT16K33_0x71_NUMERIC_X4
			default 2 if LMTZ_I2C_BUS1_HT16K33_0x71_NUMERIC_X4L
			default 3 if LMTZ_I2C_BUS1_HT16K33_0x71_ALPHANUMERIC_X4
			default 4 if LMTZ_I2C_BUS1_HT16K33_0x71_MATRIX
			default -1
			
			choice LMTZ_I2C_HT16K33_B12_TYPE
			default LMTZ_I2C_BUS1_HT16K33_0x72_DIS
			prompt "HT16K33 @0x72"
			
				config LMTZ_I2C_BUS1_HT16K33_0x72_DIS
				bool "Disabled"

				config LMTZ_I2C_BUS1_HT16K33_0x72_NUMERIC_X4
				bool "Adafruit 4 digit numeric"

				config LMTZ_I2C_BUS1_HT16K33_0x72_NUMERIC_X4L
				bool "Adafruit 4 digit numeric LARGE"
				
				config LMTZ_I2C_BUS1_HT16K33_0x72_ALPHANUMERIC_X4
				bool "Adafruit 4 character alphanumeric"

				config LMTZ_I2C_BUS1_HT16K33_0x72_MATRIX
				bool "Adafruit 8x8 matrix"

				config LMTZ_I2C_BUS1_HT16K33_0x72_OTHER
				bool "Other HT16K33"

			endchoice

			config LMTZ_I2C_BUS1_HT16K33_0x72_EN
			depends on LMTZ_I2C_BUS1_EN
			bool 
			default n if LMTZ_i2C_BUS1_HT16K33_0x72_DIS
			default y

			config LMTZ_I2C_BUS1_HT16K33_0x72_TYPE
			depends on LMTZ_I2C_BUS1_EN
			int
			default 0 if LMTZ_I2C_BUS1_HT16K33_0x72_OTHER
			default 1 if LMTZ_I2C_BUS1_HT16K33_0x72_NUMERIC_X4
			default 2 if LMTZ_I2C_BUS1_HT16K33_0x72_NUMERIC_X4L
			default 3 if LMTZ_I2C_BUS1_HT16K33_0x72_ALPHANUMERIC_X4
			default 4 if LMTZ_I2C_BUS1_HT16K33_0x72_MATRIX
			default -1
			
			choice LMTZ_I2C_HT16K33_B13_TYPE
			default LMTZ_I2C_BUS1_HT16K33_0x73_DIS
			prompt "HT16K33 @0x73"
			
				config LMTZ_I2C_BUS1_HT16K33_0x73_DIS
				bool "Disabled"

				config LMTZ_I2C_BUS1_HT16K33_0x73_NUMERIC_X4
				bool "Adafruit 4 digit numeric"

				config LMTZ_I2C_BUS1_HT16K33_0x73_NUMERIC_X4L
				bool "Adafruit 4 digit numeric LARGE"
				
				config LMTZ_I2C_BUS1_HT16K33_0x73_ALPHANUMERIC_X4
				bool "Adafruit 4 character alphanumeric"

				config LMTZ_I2C_BUS1_HT16K33_0x73_MATRIX
				bool "Adafruit 8x8 matrix"

				config LMTZ_I2C_BUS1_HT16K33_0x73_OTHER
				bool "Other HT16K33"

			endchoice

			config LMTZ_I2C_BUS1_HT16K33_0x73_EN
			depends on LMTZ_I2C_BUS1_EN
			bool 
			default n if LMTZ_i2C_BUS1_HT16K33_0x73_DIS
			default y

			config LMTZ_I2C_BUS1_HT16K33_0x73_TYPE
			depends on LMTZ_I2C_BUS1_EN
			int
			default 0 if LMTZ_I2C_BUS1_HT16K33_0x73_OTHER
			default 1 if LMTZ_I2C_BUS1_HT16K33_0x73_NUMERIC_X4
			default 2 if LMTZ_I2C_BUS1_HT16K33_0x73_NUMERIC_X4L
			default 3 if LMTZ_I2C_BUS1_HT16K33_0x73_ALPHANUMERIC_X4
			default 4 if LMTZ_I2C_BUS1_HT16K33_0x73_MATRIX
			default -1

			choice LMTZ_I2C_HT16K33_B14_TYPE
			default LMTZ_I2C_BUS1_HT16K33_0x74_DIS
			prompt "HT16K33 @0x74"
			
				config LMTZ_I2C_BUS1_HT16K33_0x74_DIS
				bool "Disabled"

				config LMTZ_I2C_BUS1_HT16K33_0x74_NUMERIC_X4
				bool "Adafruit 4 digit numeric"

				config LMTZ_I2C_BUS1_HT16K33_0x74_NUMERIC_X4L
				bool "Adafruit 4 digit numeric LARGE"
				
				config LMTZ_I2C_BUS1_HT16K33_0x74_ALPHANUMERIC_X4
				bool "Adafruit 4 character alphanumeric"

				config LMTZ_I2C_BUS1_HT16K33_0x74_MATRIX
				bool "Adafruit 8x8 matrix"

				config LMTZ_I2C_BUS1_HT16K33_0x74_OTHER
				bool "Other HT16K33"

			endchoice

			config LMTZ_I2C_BUS1_HT16K33_0x74_EN
			depends on LMTZ_I2C_BUS1_EN
			bool 
			default n if LMTZ_i2C_BUS1_HT16K33_0x74_DIS
			default y

			config LMTZ_I2C_BUS1_HT16K33_0x74_TYPE
			depends on LMTZ_I2C_BUS1_EN
			int
			default 0 if LMTZ_I2C_BUS1_HT16K33_0x74_OTHER
			default 1 if LMTZ_I2C_BUS1_HT16K33_0x74_NUMERIC_X4
			default 2 if LMTZ_I2C_BUS1_HT16K33_0x74_NUMERIC_X4L
			default 3 if LMTZ_I2C_BUS1_HT16K33_0x74_ALPHANUMERIC_X4
			default 4 if LMTZ_I2C_BUS1_HT16K33_0x74_MATRIX
			default -1

			choice LMTZ_I2C_HT16K33_B15_TYPE
			default LMTZ_I2C_BUS1_HT16K33_0x75_DIS
			prompt "HT16K33 @0x75"
			
				config LMTZ_I2C_BUS1_HT16K33_0x75_DIS
				bool "Disabled"

				config LMTZ_I2C_BUS1_HT16K33_0x75_NUMERIC_X4
				bool "Adafruit 4 digit numeric"

				config LMTZ_I2C_BUS1_HT16K33_0x75_NUMERIC_X4L
				bool "Adafruit 4 digit numeric LARGE"
				
				config LMTZ_I2C_BUS1_HT16K33_0x75_ALPHANUMERIC_X4
				bool "Adafruit 4 character alphanumeric"

				config LMTZ_I2C_BUS1_HT16K33_0x75_MATRIX
				bool "Adafruit 8x8 matrix"

				config LMTZ_I2C_BUS1_HT16K33_0x75_OTHER
				bool "Other HT16K33"

			endchoice

			config LMTZ_I2C_BUS1_HT16K33_0x75_EN
			depends on LMTZ_I2C_BUS1_EN
			bool 
			default n if LMTZ_i2C_BUS1_HT16K33_0x75_DIS
			default y

			config LMTZ_I2C_BUS1_HT16K33_0x75_TYPE
			depends on LMTZ_I2C_BUS1_EN
			int
			default 0 if LMTZ_I2C_BUS1_HT16K33_0x75_OTHER
			default 1 if LMTZ_I2C_BUS1_HT16K33_0x75_NUMERIC_X4
			default 2 if LMTZ_I2C_BUS1_HT16K33_0x75_NUMERIC_X4L
			default 3 if LMTZ_I2C_BUS1_HT16K33_0x75_ALPHANUMERIC_X4
			default 4 if LMTZ_I2C_BUS1_HT16K33_0x75_MATRIX
			default -1

			choice LMTZ_I2C_HT16K33_B16_TYPE
			default LMTZ_I2C_BUS1_HT16K33_0x76_DIS
			prompt "HT16K33 @0x76"
			
				config LMTZ_I2C_BUS1_HT16K33_0x76_DIS
				bool "Disabled"

				config LMTZ_I2C_BUS1_HT16K33_0x76_NUMERIC_X4
				bool "Adafruit 4 digit numeric"

				config LMTZ_I2C_BUS1_HT16K33_0x76_NUMERIC_X4L
				bool "Adafruit 4 digit numeric LARGE"
				
				config LMTZ_I2C_BUS1_HT16K33_0x76_ALPHANUMERIC_X4
				bool "Adafruit 4 character alphanumeric"

				config LMTZ_I2C_BUS1_HT16K33_0x76_MATRIX
				bool "Adafruit 8x8 matrix"

				config LMTZ_I2C_BUS1_HT16K33_0x76_OTHER
				bool "Other HT16K33"

			endchoice

			config LMTZ_I2C_BUS1_HT16K33_0x76_EN
			depends on LMTZ_I2C_BUS1_EN
			bool 
			default n if LMTZ_i2C_BUS1_HT16K33_0x76_DIS
			default y

			config LMTZ_I2C_BUS1_HT16K33_0x76_TYPE
			depends on LMTZ_I2C_BUS1_EN
			int
			default 0 if LMTZ_I2C_BUS1_HT16K33_0x76_OTHER
			default 1 if LMTZ_I2C_BUS1_HT16K33_0x76_NUMERIC_X4
			default 2 if LMTZ_I2C_BUS1_HT16K33_0x76_NUMERIC_X4L
			default 3 if LMTZ_I2C_BUS1_HT16K33_0x76_ALPHANUMERIC_X4
			default 4 if LMTZ_I2C_BUS1_HT16K33_0x76_MATRIX
			default -1


			choice LMTZ_I2C_HT16K33_B17_TYPE
			default LMTZ_I2C_BUS1_HT16K33_0x77_DIS
			prompt "HT16K33 @0x77"
			
				config LMTZ_I2C_BUS1_HT16K33_0x77_DIS
				bool "Disabled"

				config LMTZ_I2C_BUS1_HT16K33_0x77_NUMERIC_X4
				bool "Adafruit 4 digit numeric"

				config LMTZ_I2C_BUS1_HT16K33_0x77_NUMERIC_X4L
				bool "Adafruit 4 digit numeric LARGE"
				
				config LMTZ_I2C_BUS1_HT16K33_0x77_ALPHANUMERIC_X4
				bool "Adafruit 4 character alphanumeric"

				config LMTZ_I2C_BUS1_HT16K33_0x77_MATRIX
				bool "Adafruit 8x8 matrix"

				config LMTZ_I2C_BUS1_HT16K33_0x77_OTHER
				bool "Other HT16K33"

			endchoice

			config LMTZ_I2C_BUS1_HT16K33_0x77_EN
			depends on LMTZ_I2C_BUS1_EN
			bool 
			default n if LMTZ_i2C_BUS1_HT16K33_0x77_DIS
			default y

			config LMTZ_I2C_BUS1_HT16K33_0x77_TYPE
			depends on LMTZ_I2C_BUS1_EN
			int
			default 0 if LMTZ_I2C_BUS1_HT16K33_0x77_OTHER
			default 1 if LMTZ_I2C_BUS1_HT16K33_0x77_NUMERIC_X4
			default 2 if LMTZ_I2C_BUS1_HT16K33_0x77_NUMERIC_X4L
			default 3 if LMTZ_I2C_BUS1_HT16K33_0x77_ALPHANUMERIC_X4
			default 4 if LMTZ_I2C_BUS1_HT16K33_0x77_MATRIX
			default -1

		endmenu
	
endmenu
```

## components/limitz/network/Kconfig
```kconfig
menu "LIMITZ networking"
	config LMTZ_WIFI_SSID
		prompt "SSID"
		string
		default "LimitzNet"

	config LMTZ_WIFI_PASSWORD
		prompt "Password"
		string
		default "LimitzNet"

endmenu
```

## components/limitz/radio/Kconfig
```kconfig
menu "LIMITZ Radio"
	menuconfig LMTZ_RADIO
		prompt "Enable ESP-NOW Radio"
		bool
		default n

		config LMTZ_RADIO_CHANNEL
		depends on LMTZ_RADIO
		int "Channel"
        	default 1
        	range 1 13

		config LMTZ_RADIO_PACKET_PAYLOAD_SIZE
		depends on LMTZ_RADIO
		int "Packet payload capacity"
		default 128
		range 16 224

		config LMTZ_RADIO_LONGRANGE
		depends on LMTZ_RADIO
		bool "Enable long range"
		default y
		help
			When enabled, the PHY rate of ESP32 will be 512Kbps or 256Kbps

		config LMTZ_RADIO_PMK
		depends on LMTZ_RADIO
		string "Primary master key (must be 16 chars long)"
		default "LMTZPMK_01234567"

		config LMTZ_RADIO_LMK
		depends on LMTZ_RADIO
		string "Local master key (must be 16 chars long)"
		default "LMTZLMK_01234567"

		config LMTZ_RADIO_PACKET_QUEUE_LEN
		depends on LMTZ_RADIO
		int "RX Packet queue size"
		default 10
		
endmenu
```

## components/limitz/sdcard/Kconfig
```kconfig
menu "LIMITZ SD Card"

	# ENCODER 1
	config LMTZ_SDCARD
		bool
		prompt "Enable SD Card"
		default n
	
	choice LMTZ_SDCARD_SLOT
		depends on LMTZ_SDCARD
		default LMTZ_SDCARD_SLOT_1
		prompt "SDMMC Slot"

		config LMTZ_SDCARD_SLOT_0
		bool "Slot 0"
		help
			CMD, CLK, D0-7 = GGPIOs 11,6,7,8,9,10,16,17,5,18

		config LMTZ_SDCARD_SLOT_1
		bool  "Slot 1"
		help
			CMD, CLK, D0-3 = GPIOs 15,14,2,4,12,13
	endchoice

	config LMTZ_SDCARD_CD_PIN
		int "CD Pin"
		range -1-31
		default -1
	
	config LMTZ_SDCARD_WP_PIN
		int "WP Pin"
		range -1-31
		default -1

	choice LMTZ_SDCARD_SPEED_MODE
		depends on LMTZ_SDCARD
		prompt "
	endchoice
endmenu
```

## components/limitz/servo/Kconfig
```kconfig
menu "LIMITZ analog servo"


	# SERVO 1
	config LMTZ_SERVO1
		bool
		prompt "Enable servo 1"
		default n
	
	menu "Configuration"
		depends on LMTZ_SERVO1

		config LMTZ_SERVO1_PIN
			int
			prompt "GPIO pin"
			default 17
	
		config LMTZ_SERVO1_MIN_INPUT
			int 
			prompt "Minimum input value"
			default -1000

		config LMTZ_SERVO1_MAX_INPUT
			int
			prompt "Maximum input value"
			default 1000

		config LMTZ_SERVO1_CHANNEL
			int
			prompt "LEDC Channel" 
			default 0

		config LMTZ_SERVO1_MIN_VALUE
			int
			prompt "Min period in us"
			default 500 
		
		config LMTZ_SERVO1_MAX_VALUE
			int
			prompt "Max period in us"
			default 2500
	endmenu
	# SERVO 2
	config LMTZ_SERVO2
		bool
		prompt "Enable servo 2"
		default n
	
	menu "Configuration"
		depends on LMTZ_SERVO2

		config LMTZ_SERVO2_PIN
			int
			prompt "GPIO pin"
			default 18
	
		config LMTZ_SERVO2_MIN_INPUT
			int 
			prompt "Minimum input value"
			default -1000

		config LMTZ_SERVO2_MAX_INPUT
			int
			prompt "Maximum input value"
			default 1000

		config LMTZ_SERVO2_CHANNEL
			int
			prompt "LEDC Channel" 
			default 0

		config LMTZ_SERVO2_MIN_VALUE
			int
			prompt "Min period in us"
			default 500 
		
		config LMTZ_SERVO2_MAX_VALUE
			int
			prompt "Max period in us"
			default 2500
	endmenu
endmenu
```
