## components/limitz/adc/Kconfig
```kconfig
menu "LIMITZ ADC"

	# ADC1
	config LMTZ_ADC1
		bool
		prompt "Enable Battery Monitor"
		default n
	
		menuconfig LMTZ_ADC1_HAS_PIN_EN:
			depends on LMTZ_ADC1
			prompt "Is the ADC enabled by setting a specific pin?"
			bool
			help
				TTGO uses pin 14
			default n

		config LMTZ_ADC1_PIN_EN
			depends on LMTZ_ADC1_HAS_PIN_EN
			prompt "Pin that enables the ADC"
			int
			range 0 33
			default 14

		config LMTZ_ADC1_PIN_EN_LEVEL
			depends on LMTZ_ADC1_HAS_PIN_EN
			prompt "Pin enables the ADC with level high"
			bool
			default y
		choice LMTZ_ADC1_TYPE
			depends on LMTZ_ADC1
			prompt "Battery type"
			default LMTZ_ADC1_TYPE_LIPO
			
			config LMTZ_ADC1_TYPE_LIPO
			bool "LiPo 3.7V"

			config LMTZ_ADC1_TYPE_LIPO
			bool "Li-Ion 18650 3.6V"
			
			config LMTZ_ADC1_TYPE_COIN
			bool "Coin cell 3V"

		endchoice

		choice LMTZ_ADC1_CHANNEL_SELECT
			depends on LMTZ_ADC1
			prompt "Channel"
			default LMTZ_ADC1_CHANNEL0

			config LMTZ_ADC1_CHANNEL0
			bool "Channel 0, pin 36"

			config LMTZ_ADC1_CHANNEL1
			bool "Channel 1, pin 37"

			config LMTZ_ADC1_CHANNEL2
			bool "Channel 2, pin 38"

			config LMTZ_ADC1_CHANNEL3
			bool "Channel 3, pin 39"

			config LMTZ_ADC1_CHANNEL4
			bool "Channel 4, pin 32"

			config LMTZ_ADC1_CHANNEL5
			bool "Channel 5, pin 33"

			config LMTZ_ADC1_CHANNEL6
			bool "Channel 6, pin 34"

			config LMTZ_ADC1_CHANNEL7
			bool "Channel 7, pin 35"

		endchoice

		choice LMTZ_ADC1_WINDOW_SELECT
			depends on LMTZ_ADC1
			prompt "Window mode"
			default LMTZ_ADC1_WINDOW16

			config LMTZ_ADC1_WINDOW0
			bool "No sliding window"

			config LMTZ_ADC1_WINDOW4
			bool "Sliding window (4)"

			config LMTZ_ADC1_WINDOW16
			bool "Sliding window (16)"
			
			config LMTZ_ADC1_WINDOW32
			bool "Sliding window (32)"

			config LMTZ_ADC1_WINDOW64
			bool "Sliding window (64)"
		endchoice

	


		config LMTZ_ADC1_TYPE
			depends on LMTZ_ADC1
			int
			default   0 if LMTZ_ADC1_TYPE_GENERIC
			default 100 if LMTZ_ADC1_TYPE_ADC1
			default 121 if LMTZ_ADC1_TYPE_JOY_X
			default 122 if LMTZ_ADC1_TYPE_JOY_Y

		config LMTZ_ADC1_WINDOW_SIZE
			depends on LMTZ_ADC1
			int
			default 0 if LMTZ_ADC1_WINDOW0
			default 4 if LMTZ_ADC1_WINDOW4
			default 16 if LMTZ_ADC1_WINDOW16
			default 32 if LMTZ_ADC1_WINDOW32
			default 64 if LMTZ_ADC1_WINDOW64
			default 16

		config LMTZ_ADC1_CHANNEL
			depends on LMTZ_ADC1
			int
			default 0 if LMTZ_ADC1_CHANNEL0
			default 1 if LMTZ_ADC1_CHANNEL1
			default 2 if LMTZ_ADC1_CHANNEL2
			default 3 if LMTZ_ADC1_CHANNEL3
			default 4 if LMTZ_ADC1_CHANNEL4
			default 5 if LMTZ_ADC1_CHANNEL5
			default 6 if LMTZ_ADC1_CHANNEL6
			default 7 if LMTZ_ADC1_CHANNEL7
			default -1

		config LMTZ_ADC1_PIN
			depends on LMTZ_ADC1
			int 
			default 36 if LMTZ_ADC1_CHANNEL0
			default 37 if LMTZ_ADC1_CHANNEL1
			default 38 if LMTZ_ADC1_CHANNEL2
			default 39 if LMTZ_ADC1_CHANNEL3
			default 32 if LMTZ_ADC1_CHANNEL4
			default 33 if LMTZ_ADC1_CHANNEL5
			default 34 if LMTZ_ADC1_CHANNEL6
			default 35 if LMTZ_ADC1_CHANNEL7
			default -1

# ADC2
	config LMTZ_ADC2
		bool
		prompt "Enable Joystick"
		default n
	
		choice LMTZ_ADC2X_CHANNEL_SELECT
			depends on LMTZ_ADC2
			prompt "X Channel"
			default LMTZ_ADC2X_CHANNEL1

			config LMTZ_ADC2X_CHANNEL0
			bool "Channel 0, pin 36"

			config LMTZ_ADC2X_CHANNEL1
			bool "Channel 1, pin 37"

			config LMTZ_ADC2X_CHANNEL2
			bool "Channel 2, pin 38"

			config LMTZ_ADC2X_CHANNEL3
			bool "Channel 3, pin 39"

			config LMTZ_ADC2X_CHANNEL4
			bool "Channel 4, pin 32"

			config LMTZ_ADC2X_CHANNEL5
			bool "Channel 5, pin 33"

			config LMTZ_ADC2X_CHANNEL6
			bool "Channel 6, pin 34"

			config LMTZ_ADC2X_CHANNEL7
			bool "Channel 7, pin 35"

		endchoice


		choice LMTZ_ADC2Y_CHANNEL_SELECT
			depends on LMTZ_ADC2
			prompt "Y Channel"
			default LMTZ_ADC2Y_CHANNEL2

			config LMTZ_ADC2Y_CHANNEL0
			bool "Channel 0, pin 36"

			config LMTZ_ADC2Y_CHANNEL1
			bool "Channel 1, pin 37"

			config LMTZ_ADC2Y_CHANNEL2
			bool "Channel 2, pin 38"

			config LMTZ_ADC2Y_CHANNEL3
			bool "Channel 3, pin 39"

			config LMTZ_ADC2Y_CHANNEL4
			bool "Channel 4, pin 32"

			config LMTZ_ADC2Y_CHANNEL5
			bool "Channel 5, pin 33"

			config LMTZ_ADC2Y_CHANNEL6
			bool "Channel 6, pin 34"

			config LMTZ_ADC2Y_CHANNEL7
			bool "Channel 7, pin 35"
		endchoice


		choice LMTZ_ADC2_WINDOW_SELECT
			depends on LMTZ_ADC2
			prompt "Window mode"
			default LMTZ_ADC2_WINDOW16

			config LMTZ_ADC2_WINDOW0
			bool "No sliding window"

			config LMTZ_ADC2_WINDOW4
			bool "Sliding window (4)"

			config LMTZ_ADC2_WINDOW16
			bool "Sliding window (16)"
			
			config LMTZ_ADC2_WINDOW32
			bool "Sliding window (32)"

			config LMTZ_ADC2_WINDOW64
			bool "Sliding window (64)"
		endchoice

		config LMTZ_ADC2_WINDOW_SIZE
			depends on LMTZ_ADC2
			int
			default 0 if LMTZ_ADC2_WINDOW0
			default 4 if LMTZ_ADC2_WINDOW4
			default 16 if LMTZ_ADC2_WINDOW16
			default 32 if LMTZ_ADC2_WINDOW32
			default 64 if LMTZ_ADC2_WINDOW64
			default 16

		config LMTZ_ADC2X_CHANNEL
			depends on LMTZ_ADC2
			int
			default 0 if LMTZ_ADC2X_CHANNEL0
			default 1 if LMTZ_ADC2X_CHANNEL1
			default 2 if LMTZ_ADC2X_CHANNEL2
			default 3 if LMTZ_ADC2X_CHANNEL3
			default 4 if LMTZ_ADC2X_CHANNEL4
			default 5 if LMTZ_ADC2X_CHANNEL5
			default 6 if LMTZ_ADC2X_CHANNEL6
			default 7 if LMTZ_ADC2X_CHANNEL7
			default -1

		config LMTZ_ADC2Y_CHANNEL
			depends on LMTZ_ADC2
			int 
			default 0 if LMTZ_ADC2Y_CHANNEL0
			default 1 if LMTZ_ADC2Y_CHANNEL1
			default 2 if LMTZ_ADC2Y_CHANNEL2
			default 3 if LMTZ_ADC2Y_CHANNEL3
			default 4 if LMTZ_ADC2Y_CHANNEL4
			default 5 if LMTZ_ADC2Y_CHANNEL5
			default 6 if LMTZ_ADC2Y_CHANNEL6
			default 7 if LMTZ_ADC2Y_CHANNEL7
			default -1
		
		config LMTZ_ADC2X_PIN
			depends on LMTZ_ADC2
			int 
			default 36 if LMTZ_ADC2X_CHANNEL0
			default 37 if LMTZ_ADC2X_CHANNEL1
			default 38 if LMTZ_ADC2X_CHANNEL2
			default 39 if LMTZ_ADC2X_CHANNEL3
			default 32 if LMTZ_ADC2X_CHANNEL4
			default 33 if LMTZ_ADC2X_CHANNEL5
			default 34 if LMTZ_ADC2X_CHANNEL6
			default 35 if LMTZ_ADC2X_CHANNEL7
			default -1

		config LMTZ_ADC2Y_PIN
			depends on LMTZ_ADC2
			int 
			default 36 if LMTZ_ADC2Y_CHANNEL0
			default 37 if LMTZ_ADC2Y_CHANNEL1
			default 38 if LMTZ_ADC2Y_CHANNEL2
			default 39 if LMTZ_ADC2Y_CHANNEL3
			default 32 if LMTZ_ADC2Y_CHANNEL4
			default 33 if LMTZ_ADC2Y_CHANNEL5
			default 34 if LMTZ_ADC2Y_CHANNEL6
			default 35 if LMTZ_ADC2Y_CHANNEL7
			default -1



endmenu
```

## components/limitz/audio/Kconfig
```kconfig
menu "LIMITZ Audio"
		config LMTZ_AUDIO_PMK
		string "Primary master key (must be 16 chars long)"
		default "LMTZPMK_01234567"

endmenu
```

## components/limitz/ble/Kconfig
```kconfig
menu "LIMITZ networking"
	config LMTZ_WIFI
		prompt "Connect to WIFI"
		bool
		default n

		config LMTZ_WIFI_SSID
			depends on LMTZ_WIFI
			prompt "SSID"
			string
			default "LimitzNet"

		config LMTZ_WIFI_PASSWORD
			depends on LMTZ_WIFI
			prompt "Password"
			string
			default "LimitzNet"

	config LMTZ_SERVER
		prompt "Start server" if !LMTZ_ESPNOW
		bool
		default n

		config LMTZ_SERVER_PORT
			depends on LMTZ_SERVER
			prompt "Server listens on port"
			int
			default 13666
	
	config LMTZ_CLIENT
		prompt "Start client"
		bool
		default n

		config LMTZ_SERVER_IP
			depends on LMTZ_CLIENT
			prompt "Client connects to IP"
			string
			default "127.0.0.1"

		config LMTZ_SERVER_PORT
			depends on LMTZ_CLIENT
			prompt "Client connects to port"
			int
			default 13666
endmenu
```

## components/limitz/dmx512/Kconfig
```kconfig
menu "LIMITZ DMX512"

	
	config LMTZ_DMX_U1_EN
		bool
		prompt "Enable DMX Universe 1"
		default n
	
	menu "Configuration"
		depends on LMTZ_DMX_U1_EN

		config LMTZ_DMX_U1_PIN
			int
			prompt "GPIO pin"
			default 17

		config LMTZ_DMX_U1_UART
			int
			prompt "UART number"
			default 2

		config LMTZ_DMX_U1_NUM_CHANNELS
			int "Number of channels in a frame"
			default 32
			range 24 512
			help
				Maximum of 512 allowed
	
		config LMTZ_DMX_NUM_BUFFERS
			int "Number of frame buffers"
			default 2
			range 1 8
	endmenu
endmenu
```

## components/limitz/encoder/Kconfig
```kconfig
menu "LIMITZ encoder"

	# ENCODER 1
	config LMTZ_ENCODER_1
		bool
		prompt "Enable encoder 1"
		default n
	
	menu "Configuration"
		depends on LMTZ_ENCODER_1

		config LMTZ_ENCODER_1_UNIT
			int
			prompt "Pulse counter unit"
			default 0

		config LMTZ_ENCODER_1_CHANNEL
			int
			prompt "Pulse counter channel"
			default 0

		config LMTZ_ENCODER_1_PIN_A
			int
			prompt "GPIO pin A"
			default 26
	
		config LMTZ_ENCODER_1_PIN_B
			int
			prompt "GPIO pin B"
			default 27

		config LMTZ_ENCODER_1_PIN_PB
			int
			prompt "GPIO pin for push button"
			default -1
		
		config LMTZ_ENCODER_1_INIT_VALUE
			int 
			prompt "Init value"
			default 0
		
		config LMTZ_ENCODER_1_MIN_VALUE
			int 
			prompt "Minimum value"
			default -100

		config LMTZ_ENCODER_1_MAX_VALUE
			int
			prompt "Maximum value"
			default 100
		config LMTZ_ENCODER_1_FILTER_VALUE
			int
			prompt "Filter value"
			default 256

		config LMTZ_ENCODER_1_PULSES_PER_STEP
			int
			prompt "Pulses per step" 
			default 4

		config LMTZ_ENCODER_1_DELTA_PER_STEP
			int
			prompt "Delta d(v) per step"
			default 1 
		
	endmenu
endmenu
```

## components/limitz/grove/Kconfig
```kconfig
menu "LIMITZ Peripherals"

	menuconfig LMTZ_TRACKBALL_EN
	bool "Enable Grove Trackball"
	default 0

		config LMTZ_TRACKBALL_PORT
		depends on LMTZ_TRACKBALL_EN
		int "Trackball I2C Port"
		range 0 1

		config LMTZ_TRACKBALL_ADDR
		depends on LMTZ_TRACKBALL_EN
		int "Trackball I2C Addr"

endmenu
```

## components/limitz/gui/Kconfig
```kconfig
menu "LIMITZ Display"

	config LMTZ_BACKLIGHT_PIN
	int "Backlight GPIO Pin (#)"
	default 4

	menuconfig LMTZ_BACKLIGHT_PWM_EN
	bool "Enable PWM"

		config LMTZ_BACKLIGHT_TIMER
		int "LEDC Timer (#)"
		depends on LMTZ_BACKLIGHT_PWM_EN
		range 0 7
		default 0

		config LMTZ_BACKLIGHT_CHANNEL
		depends on LMTZ_BACKLIGHT_PWM_EN
		int "LEDC Channel (#)"
		range 0 7
		default 1
	
		config LMTZ_BACKLIGHT_PWM_FREQ
		depends on LMTZ_BACKLIGHT_PWM_EN
		int "PWM Frequency (Hz)"
		default 300

		config LMTZ_BACKLIGHT_PWM_BITS
		depends on LMTZ_BACKLIGHT_PWM_EN
		int "PWM Resolution (bits)"
		default 12

		config LMTZ_BACKLIGHT_SCALE_ON
		depends on LMTZ_BACKLIGHT_PWM_EN
		int "LEDC Fade cycles to ON"
		default 10

		config LMTZ_BACKLIGHT_SCALE_DIM
		depends on LMTZ_BACKLIGHT_PWM_EN
		int "LEDC Fade cycles to DIMMED"
		default 1

		config LMTZ_BACKLIGHT_SCALE_OFF
		depends on LMTZ_BACKLIGHT_PWM_EN
		int "LEDC Fade cycles to OFF"
		default 20

		config LMTZ_BACKLIGHT_CYCLES
		depends on LMTZ_BACKLIGHT_PWM_EN
		int "LEDC ticks per cycle"
		default 1

		
		config LMTZ_BACKLIGHT_LEVEL_ON
		depends on LMTZ_BACKLIGHT_PWM_EN
		int "Duty cycle ON (%)"
		default 100
		range 0 100

		config LMTZ_BACKLIGHT_LEVEL_DIM
		depends on LMTZ_BACKLIGHT_PWM_EN
		int "Duty cycle DIMMED (%)"
		default 50
		range 0 100
		
		config LMTZ_BACKLIGHT_LEVEL_OFF
		depends on LMTZ_BACKLIGHT_PWM_EN
		int "Duty cycle OFF (%)"
		default 0
		range 0 100

		config LMTZ_BACKLIGHT_DIMS_AFTER_SEC
		depends on LMTZ_BACKLIGHT_PWM_EN
		int "Automatically dim after (sec)"
		default 30
		help
			Use 0 to never dim

		config LMTZ_BACKLIGHT_OFF_AFTER_SEC
		depends on LMTZ_BACKLIGHT_PWM_EN
		int "Automatically turn off after (sec)"
		default 180
		help
			Use 0 to never turn off


endmenu
```

## components/limitz/i2cbase/Kconfig
```kconfig
menu "LIMITZ I2C"

	config LMTZ_I2CPORT0_EN
	bool "Enable port 0"

		config LMTZ_I2CPORT0_SDA
		depends on LMTZ_I2CPORT0_EN
		int "SDA Pin number" 
		range 0 31
		default 21
	
		config LMTZ_I2CPORT0_SCL
		depends on LMTZ_I2CPORT0_EN
		int "SCL Pin number"
		range 0 31
		default 22
	
		choice LMTZ_I2CPORT0_FREQ_SELECT	
		depends on LMTZ_I2CPORT0_EN
		prompt "Frequency"
			config  LMTZ_I2CPORT0_FREQ_1
			bool "1 Mhz"

			config  LMTZ_I2CPORT0_FREQ_5
			bool "5 Mhz"

			config  LMTZ_I2CPORT0_FREQ_10
			bool "10 Mhz"

			config  LMTZ_I2CPORT0_FREQ_20
			bool "20 Mhz"

		endchoice

		config LMTZ_I2CPORT0_FREQUENCY
		depends on LMTZ_I2CPORT0_EN
		int
		default 1000000  if LMTZ_I2CPORT0_FREQ_1
		default 5000000  if LMTZ_I2CPORT0_FREQ_5
		default 10000000 if LMTZ_I2CPORT0_FREQ_10
		default 20000000 if LMTZ_I2CPORT0_FREQ_20


	config LMTZ_I2CPORT1_EN
	bool "Enable port 1"

		config LMTZ_I2CPORT1_SDA
		depends on LMTZ_I2CPORT1_EN
		int "SDA Pin number" 
		range 0 31
		default 26
	
		config LMTZ_I2CPORT1_SCL
		depends on LMTZ_I2CPORT1_EN
		int "SCL Pin number"
		range 0 31
		default 27
	
		choice LMTZ_I2CPORT1_FREQ_SELECT	
		depends on LMTZ_I2CPORT1_EN
		prompt "Frequency"
			config  LMTZ_I2CPORT1_FREQ_1
			bool "1 Mhz"

			config  LMTZ_I2CPORT1_FREQ_5
			bool "5 Mhz"

			config  LMTZ_I2CPORT1_FREQ_10
			bool "10 Mhz"

			config  LMTZ_I2CPORT1_FREQ_20
			bool "20 Mhz"

		endchoice

		config LMTZ_I2CPORT1_FREQUENCY
		depends on LMTZ_I2CPORT1_EN
		int
		default 1000000  if LMTZ_I2CPORT1_FREQ_1
		default 5000000  if LMTZ_I2CPORT1_FREQ_5
		default 10000000 if LMTZ_I2CPORT1_FREQ_10
		default 20000000 if LMTZ_I2CPORT1_FREQ_20



endmenu
```
