## components/limitz/tmc5160/Kconfig
```kconfig
menu "LIMITZ TMC5160 (SPI)"

	choice LMTZ_TMC5160_MODE
		prompt "TMC5160 Mode"
		default LMTZ_TMC5160_MODE_MOTION_CONTROLLER

		config LMTZ_TMC5160_MODE_MOTION_CONTROLLER
		bool "Motion Controller"

		config LMTZ_TMC5160_MODE_STEP_DIR
		bool "Step Dir"

		config LMTZ_TMC5160_MODE_BY_GPIO
		bool "Settable with GPIO"

	endchoice
	
	config LMTZ_TMC5160_MODE_CONFIG_PIN
		depends on LMTZ_TMC5160_MODE_BY_GPIO
		int "GPIO pin for mode selection"
		range 0 45
		default 0
	
	config LMTZ_TMC5160_PIN_STEP
		depends on LMTZ_TMC5160_MODE_STEP_DIR || LMTZ_TMC5160_MODE_BY_GPIO
		int "Step pin"
		default 18

	config LMTZ_TMC5160_DIR_STEP
		depends on LMTZ_TMC5160_MODE_STEP_DIR || LMTZ_TMC5160_MODE_BY_GPIO
		int "Dir pin"
		default 19
	
	config LMTZ_TMC5160_DAISY_NUM
		int
		prompt "Number of TMC5160's (daisy chained if more than 1)"
		default 1
	
	choice LMTZ_TMC5160_SPI
		prompt "SPI host"
		default LMTZ_TMC5160_SPI_HSPI

		config LMTZ_TMC5160_SPI_HSPI
			bool "HSPI"
		
		config LMTZ_TMC5160_SPI_VSPI
			bool "VSPI"
	endchoice

		
	config LMTZ_TMC5160_DMA_CHANNEL
		int
		prompt "SPI DMA channel" 
		default 2
	
	config LMTZ_TMC5160_CLOCK_SPEED
		int "SPI Clock speed"
		default 1000000

	config LMTZ_TMC5160_PIN_MOSI
		int "SPI MOSI pin"
		default 13

	config LMTZ_TMC5160_PIN_MISO
		int "SPI MISO pin"
		default 12

	config LMTZ_TMC5160_PIN_SCLK
		int "SPI SCLK pin"
		default 14

	config LMTZ_TMC5160_PIN_CS
		int "SPI CS pin"
		default 15

	config LMTZ_TMC5160_PIN_EN
		int "Output enable pin"
		default 17

endmenu
```

## components/limitz/unique_id/Kconfig
```kconfig
menu "LIMITZ unique id"
	choice LMTZ_UNIQUE_ID_SRC
		prompt "Unique id source"
		default LMTZ_UNIQUE_ID_FROM_MAC
		help
			You can get the unique id from the mac address or set it yourself.

		config LMTZ_UNIQUE_ID_SRC_MAC
			bool "Generate unique id from MAC address"
		config LMTZ_UNIQUE_ID_SRC_MANUAL
			bool "Create your own unique id"
	endchoice

	config LMTZ_UNIQUE_ID_PREFIX
		depends on LMTZ_UNIQUE_ID_SRC_MAC
		string "Prefix"
		default "" if LMTZ_UNIQUE_ID_SRC_MANUAL
		default "LIMITZ-"

	config LMTZ_UNIQUE_ID_MANUAL
		depends on LMTZ_UNIQUE_ID_SRC_MANUAL
		prompt "Manually assigned id"
		string
		default "LIMITZ"

endmenu
```

## components/limitz/vfd/Kconfig
```kconfig
menu "LIMITZ VFD driver"

	config LMTZ_MAX6921_OUTPUTS
		int
		prompt "Number of VFD outputs"
		default 32
	
	choice LMTZ_MAX6921_SPI
		prompt "SPI host"
		default LMTZ_MAX6921_SPI_HSPI

		config LMTZ_MAX6921_SPI_HSPI
			bool "HSPI"
		
		config LMTZ_MAX6921_SPI_VSPI
			bool "VSPI"
	endchoice

		
	config LMTZ_MAX6921_DMA_CHANNEL
		int
		prompt "SPI DMA channel" 
		default 2

	config LMTZ_MAX6921_PIN_MOSI
		int
		prompt "MOSI pin"
		default 13

	config LMTZ_MAX6921_PIN_SCLK
		int
		prompt "SCLK pin"
		default 14

	config LMTZ_MAX6921_PIN_LOAD
		int
		prompt "LOAD pin"
		default 12

	config LMTZ_MAX6921_PIN_BLANK
		int
		prompt "BLANK pin"
		default 11

	config LMTZ_MAX6921_CLOCK_SPEED
		int
		prompt "SPI Clock speed"
		default 1000000

endmenu
```

## main/Kconfig.projbuild
```kconfig
menu "LMTZ Components"
	menu "Adafruit HT16K33 Leds"
		config HT16K33_SDA
			int
			prompt "SDA GPIO Number"
			default 21

		config HT16K33_SCL
			int
			prompt "SCL GPIO Number"
			default 22
		
		config HT16K33_FREQ
			int
			prompt "I2C Frequency"
			default 100000
	endmenu

	menu "Ledstrip APA102"
		config APA102_NUM_LEDS
			int
			prompt "Number of leds"
			default 8
	
		choice APA102_SPI_HOST
			prompt "SPI host"
			default APA102_SPI_HOST_HSPI
	
			config APA102_SPI_HOST_HSPI
				bool "HSPI"
			config APA102_SPI_HOST_VSPI
				bool "VSPI"
		endchoice

		config APA102_DMA_CHANNEL
			int
			prompt "SPI: DMA channel"
			default 2
	
		config APA102_MOSI_PIN
			int
			prompt "SPI: MOSI pin"
			default 13
			
		config APA102_SCLK_PIN
			int
			prompt "SPI: SCLK pin"
			default 14

		config APA102_CLOCK_SPEED
			int
			prompt "SPI: Clock speed"
			default 1000000
	endmenu

	menu "Battery Monitor"
		config BATTMON_SENSE_PIN
			int
			prompt "ADC voltage sense pin"
			default 34
	endmenu

endmenu
```
